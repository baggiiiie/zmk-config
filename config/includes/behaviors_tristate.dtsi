/ {
	   
    behaviors {
			  
        cmd_tab: swapper_cmd {
            compatible = "zmk,behavior-tri-state";
            #binding-cells = <0>;
            bindings = <&kt LGUI>, <&kp TAB>, <&kt LGUI>;
            ignored-key-positions = <LB3>;
        };

        ctrl_tab: swapper_ctrl {
            compatible = "zmk,behavior-tri-state";
            #binding-cells = <0>;
            bindings = <&kt LCTRL>, <&kp TAB>, <&kt LCTRL>;
            ignored-key-positions = <LB3>;
        };
    };

};
