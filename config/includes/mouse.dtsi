#include <dt-bindings/zmk/mouse.h>

&mmv {
  acceleration-exponent = <1>;
  time-to-max-speed-ms = <800>;
  delay-ms = <0>;
};

&msc {
  acceleration-exponent = <0>;
  delay-ms = <0>;
};

#define ZMK_POINTING_DEFAULT_MOVE_VAL 1500  // default: 600
#define ZMK_POINTING_DEFAULT_SCRL_VAL 20    // default: 10

#define MOUSE_LCLK &mkp LCLK
#define MOUSE_RCLK &mkp RCLK
#define MOUSE_MS_U &mmv MOVE_UP
#define MOUSE_MS_D &mmv MOVE_DOWN
#define MOUSE_MS_L &mmv MOVE_LEFT
#define MOUSE_MS_R &mmv MOVE_RIGHT
#define MOUSE_WH_U &msc SCRL_UP
#define MOUSE_WH_D &msc SCRL_DOWN
#define MOUSE_WH_L &msc SCRL_LEFT
#define MOUSE_WH_R &msc SCRL_RIGHT
// zoom in and out currently unuseable
#define ZOOM_IN &kp C_AC_ZOOM_IN
#define ZOOM_OUT &kp C_AC_ZOOM_OUT
